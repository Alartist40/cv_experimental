## firmware/sdkconfig.defaults
```kconfig
CONFIG_IDF_TARGET="esp32s3"

# Flash & PSRAM
CONFIG_ESPTOOLPY_FLASHSIZE_8MB=y
CONFIG_ESPTOOLPY_FLASHSIZE="8MB"
CONFIG_SPIRAM=y
CONFIG_SPIRAM_MODE_OCT=y
CONFIG_SPIRAM_SPEED_80M=y

# TinyUSB configuration
CONFIG_TINYUSB=y
CONFIG_TINYUSB_NET_MODE_NCM=y
CONFIG_TINYUSB_DESC_CUSTOM_PATH=""
```
